## projects/art_pi2_thermal_image/Kconfig
```kconfig
mainmenu "RT-Thread Configuration"

config BSP_DIR
    string
    option env="BSP_ROOT"
    default "."

config RTT_DIR
    string
    option env="RTT_ROOT"
    default "rt-thread"

config PKGS_DIR
    string
    option env="PKGS_ROOT"
    default "packages"

source "$RTT_DIR/Kconfig"
source "$PKGS_DIR/Kconfig"
source "$RTT_DIR/../libraries/Kconfig"

config BSP_USING_OV5640
    bool "Enable OV5640 camera preview"
    depends on BSP_USING_LVGL && BSP_USING_LCD_800_RGB && BSP_USING_PSRAM
    select BSP_USING_I2C
    select BSP_USING_I2C4
    default y

config BSP_USING_MLX90640
    bool "Enable MLX90640 thermal preview and USER1 switching"
    depends on BSP_USING_OV5640
    select BSP_USING_I2C
    select BSP_USING_I2C5
    default y

config BSP_USING_PHOTO_CAPTURE
    bool "Enable USER2 paired snapshots to TF card"
    depends on BSP_USING_MLX90640
    select BSP_USING_FS
    select BSP_USING_SDCARD_FS
    default y

config RT_STUDIO_BUILT_IN
    bool
    select ARCH_ARM_CORTEX_M7
    select RT_USING_COMPONENTS_INIT
    select RT_USING_USER_MAIN
    default y
```
